## Kconfig
```kconfig
# Color definitions to use with color settings
COLOR_BLACK   := 0
COLOR_RED     := 1
COLOR_GREEN   := 2
COLOR_YELLOW  := 3
COLOR_BLUE    := 4
COLOR_MAGENTA := 5
COLOR_CYAN    := 6
COLOR_WHITE   := 7

DT_COMPAT_ZMK_BEHAVIOR_RGBLED_WIDGET := zmk,behavior-rgbled-widget

config ZMK_BEHAVIOR_RGBLED_WIDGET
    bool
    default $(dt_compat_enabled,$(DT_COMPAT_ZMK_BEHAVIOR_RGBLED_WIDGET))
```

## boards/arm/de60_ble_red/Kconfig.board
```kconfig
# Copyright (c) 2025 Deemen17 Works
# SPDX-License-Identifier: MIT

config BOARD_DE60_BLE_RED
    bool "deky65"
    depends on SOC_NRF52840_QIAA
```

## boards/arm/de60_ble_red/Kconfig.defconfig
```kconfig
# Copyright (c) 2025 Deemen17 Works
# SPDX-License-Identifier: MIT

if BOARD_DE60_BLE_RED

config ZMK_KEYBOARD_NAME
    default "DE60 BLE RED"

if USB

config USB_NRFX
	default y

config USB_DEVICE_STACK
	default y

endif # USB

config BT_CTLR
	default BT

config ZMK_BLE
	default y

config ZMK_USB
	default y

config ZMK_BATTERY_VOLTAGE_DIVIDER
	default y

endif # BOARD_DE60_BLE_RED
```

## boards/arm/de60_ble_red/de60_ble_red_defconfig
```kconfig
# Copyright (c) 2025 Deemen17 Works
# SPDX-License-Identifier: MIT

# --- Default Configuration ---
CONFIG_SOC_SERIES_NRF52X=y
CONFIG_SOC_NRF52840_QIAA=y

# --- Board Configuration ---
CONFIG_BOARD_DE60_BLE_RED=y

CONFIG_MPU_ALLOW_FLASH_WRITE=y
CONFIG_NVS=y
CONFIG_SETTINGS_NVS=y
CONFIG_FLASH=y
CONFIG_FLASH_PAGE_LAYOUT=y
CONFIG_FLASH_MAP=y

CONFIG_ARM_MPU=y
CONFIG_PINCTRL=y
CONFIG_GPIO=y

CONFIG_USE_DT_CODE_PARTITION=y
CONFIG_BUILD_OUTPUT_UF2=y

# --- USB Configuration ---
CONFIG_USB_DEVICE_MANUFACTURER="DEEMEN17 WORKS"
CONFIG_USB_DEVICE_PRODUCT="DE60 BLE RED"

# --- RGB Underglow Configuration ---
CONFIG_ZMK_RGB_UNDERGLOW=y
CONFIG_WS2812_STRIP=y
CONFIG_ZMK_RGB_UNDERGLOW_EXT_POWER=y
CONFIG_ZMK_RGB_UNDERGLOW_AUTO_OFF_IDLE=y
CONFIG_ZMK_RGB_UNDERGLOW_ON_START=y
CONFIG_ZMK_RGB_UNDERGLOW_EFF_START=3

# --- External Power Control ---
CONFIG_ZMK_EXT_POWER=y

# --- Logging Configuration ---
CONFIG_ZMK_USB_LOGGING=n
CONFIG_SENSOR_LOG_LEVEL_DBG=n

# --- Power Management ---
# Idle timeout: 1 minutes (ms) = 60000
CONFIG_ZMK_IDLE_TIMEOUT=60000
CONFIG_ZMK_SLEEP=y
# Sleep timeout: 30 minutes (ms) = 1800000
CONFIG_ZMK_IDLE_SLEEP_TIMEOUT=1800000
CONFIG_ZMK_PM_SOFT_OFF=y

# --- Battery Configuration ---
CONFIG_ZMK_BATTERY=y
CONFIG_ZMK_BATTERY_REPORTING=y

# --- ZMK Studio Configuration ---
CONFIG_ZMK_STUDIO=y
CONFIG_ZMK_STUDIO_LOCKING=n
CONFIG_ZMK_STUDIO_LOCK_ON_DISCONNECT=n				

# --- Bluetooth Connection Configuration ---
CONFIG_BT_CTLR_TX_PWR_PLUS_8=y
CONFIG_ZMK_BLE_EXPERIMENTAL_CONN=y

# --- HID Indicators ---
CONFIG_ZMK_HID_INDICATORS=y

# --- LED Configuration ---
CONFIG_LED=y

# --- Keyscan Debounce ---
CONFIG_ZMK_KSCAN_DEBOUNCE_PRESS_MS=5
CONFIG_ZMK_KSCAN_DEBOUNCE_RELEASE_MS=5

# --- Keyscan Configuration ---
# CONFIG_ZMK_KSCAN_MATRIX_WAIT_BEFORE_INPUTS=25

# --- RGBLED Widget Configuration ---
CONFIG_RGBLED_WIDGET=y
CONFIG_RGBLED_WIDGET_CAPS=y
# CONFIG_RGBLED_WIDGET_CONN_BLINK_MS=1000
# CONFIG_RGBLED_WIDGET_SHOW_LAYER_CHANGE=y

# --- Internal Crystal Only ---
CONFIG_CLOCK_CONTROL_NRF_K32SRC_RC=y

# --- N-Key Rollover ---
CONFIG_ZMK_HID_REPORT_TYPE_NKRO=y
```

## boards/arm/de60_ble_rev1/Kconfig.board
```kconfig
# Copyright (c) 2025 Deemen17 Works
# SPDX-License-Identifier: MIT

config BOARD_DE60_BLE_REV1
    bool "de60_ble_rev1"
    depends on SOC_NRF52840_QIAA
```

## boards/arm/de60_ble_rev1/Kconfig.defconfig
```kconfig
# Copyright (c) 2025 Deemen17 Works
# SPDX-License-Identifier: MIT

if BOARD_DE60_BLE_REV1

config ZMK_KEYBOARD_NAME
    default "HKB"

if USB

config USB_NRFX
	default y

config USB_DEVICE_STACK
	default y

endif # USB

config BT_CTLR
	default BT

config ZMK_BLE
	default y

config ZMK_USB
	default y

config I2C
	default y

config ZMK_MAX17048
	default y

config ZMK_BATTERY_REPORTING
	default y

endif # BOARD_DE60_BLE_REV1
```

## boards/arm/de60_hs_ble_minila/Kconfig.board
```kconfig
# Copyright (c) 2024 Deemen17 Works
# SPDX-License-Identifier: MIT

config BOARD_DE60_HS_BLE_MINILA
    bool "de60_hs_ble_minila"
    depends on SOC_NRF52840_QIAA
```

## boards/arm/de60_hs_minila/Kconfig.defconfig
```kconfig
# Copyright (c) 2024 Deemen17 Works
# SPDX-License-Identifier: MIT

if BOARD_DE60_HS_MINILA

config ZMK_KEYBOARD_NAME
    default "DE60 MINILA BLE"

if USB_DEVICE_STACK

config USB_NRFX
    default y

endif # USB_DEVICE_STACK

config BT_CTLR
    default BT

config ZMK_BLE
    default y

config ZMK_USB
    default y

endif # BOARD_DE60_HS_MINILA
```

## boards/arm/de60_hs_minila/de60_hs_minila_defconfig
```kconfig
# Copyright (c) 2024 Deemen17 Works
# SPDX-License-Identifier: MIT

CONFIG_SOC_SERIES_NRF52X=y
CONFIG_SOC_NRF52840_QIAA=y
CONFIG_BOARD_DE60_HS_MINILA=y

# Enable MPU
CONFIG_ARM_MPU=y

CONFIG_PINCTRL=y

# enable GPIO
CONFIG_GPIO=y

CONFIG_USE_DT_CODE_PARTITION=y
CONFIG_BUILD_OUTPUT_UF2=y

CONFIG_MPU_ALLOW_FLASH_WRITE=y
CONFIG_NVS=y
CONFIG_SETTINGS_NVS=y
CONFIG_FLASH=y
CONFIG_FLASH_PAGE_LAYOUT=y
CONFIG_FLASH_MAP=y

CONFIG_ZMK_RGB_UNDERGLOW=y
CONFIG_WS2812_STRIP=y

CONFIG_ZMK_RGB_UNDERGLOW_HUE_START=160
CONFIG_ZMK_RGB_UNDERGLOW_EFF_START=3
CONFIG_ZMK_RGB_UNDERGLOW_BRT_MIN=10
CONFIG_ZMK_RGB_UNDERGLOW_BRT_MAX=50

#Enable deep sleep support
CONFIG_ZMK_SLEEP=y
CONFIG_ZMK_RGB_UNDERGLOW_AUTO_OFF_IDLE=y

# Turn on logging, and set ZMK logging to debug output
CONFIG_ZMK_USB_LOGGING=y
CONFIG_SENSOR_LOG_LEVEL_DBG=y

CONFIG_ZMK_EXT_POWER=y

CONFIG_ZMK_PM_SOFT_OFF=y

# Battery Level
CONFIG_ZMK_BATTERY=y
CONFIG_ZMK_BATTERY_REPORTING=y
CONFIG_SENSOR=y

# Enable ZMK Studio
CONFIG_ZMK_STUDIO=y
CONFIG_ZMK_STUDIO_LOCKING=n
CONFIG_ZMK_STUDIO_LOCK_ON_DISCONNECT=n

CONFIG_ZMK_HID_INDICATORS=y
CONFIG_LED=y

CONFIG_USB_DEVICE_MANUFACTURER="DEEMEN17 WORKS"
CONFIG_USB_DEVICE_PRODUCT="DE60 HS MINILA"
```

## boards/arm/deky65/Kconfig.board
```kconfig
# Copyright (c) 2024 Deemen17 Works
# SPDX-License-Identifier: MIT

config BOARD_DEKY65
    bool "deky65"
    depends on SOC_NRF52840_QIAA
```

## boards/arm/deky65/Kconfig.defconfig
```kconfig
# Copyright (c) 2025 Deemen17 Works
# SPDX-License-Identifier: MIT

if BOARD_DEKY65

config ZMK_KEYBOARD_NAME
    default "DEKY65 BLE"

if USB

config USB_NRFX
	default y

config USB_DEVICE_STACK
	default y

endif # USB

config BT_CTLR
	default BT

config ZMK_BLE
	default y

config ZMK_USB
	default y

endif # BOARD_DEKY65
```

## boards/arm/deky65/deky65_defconfig
```kconfig
# Copyright (c) 2025 Deemen17 Works
# SPDX-License-Identifier: MIT

CONFIG_SOC_SERIES_NRF52X=y
CONFIG_SOC_NRF52840_QIAA=y
CONFIG_BOARD_DEKY65=y

# Enable MPU
CONFIG_ARM_MPU=y

CONFIG_PINCTRL=y

# Enable GPIO
CONFIG_GPIO=y

CONFIG_USE_DT_CODE_PARTITION=y
CONFIG_BUILD_OUTPUT_UF2=y

CONFIG_MPU_ALLOW_FLASH_WRITE=y
CONFIG_NVS=y
CONFIG_SETTINGS_NVS=y
CONFIG_FLASH=y
CONFIG_FLASH_PAGE_LAYOUT=y
CONFIG_FLASH_MAP=y

# Enable RGB Underglow
CONFIG_ZMK_RGB_UNDERGLOW=n
CONFIG_WS2812_STRIP=n

# External Power Control
CONFIG_ZMK_EXT_POWER=n

# Configure RGB Underglow
CONFIG_ZMK_RGB_UNDERGLOW_EXT_POWER=n
CONFIG_ZMK_RGB_UNDERGLOW_AUTO_OFF_IDLE=n
CONFIG_ZMK_RGB_UNDERGLOW_ON_START=n

# Logging
CONFIG_ZMK_USB_LOGGING=y
CONFIG_SENSOR_LOG_LEVEL_DBG=y

# Power Management Configuration
CONFIG_ZMK_IDLE_TIMEOUT=600000  
# 10 minutes
CONFIG_ZMK_SLEEP=y
CONFIG_ZMK_IDLE_SLEEP_TIMEOUT=1200000  
# 20 minutes
CONFIG_ZMK_PM_SOFT_OFF=y

# Battery Level
CONFIG_ZMK_BATTERY=y
CONFIG_ZMK_BATTERY_REPORTING=y
CONFIG_SENSOR=y

# ZMK Studio Configuration
CONFIG_ZMK_STUDIO=y
CONFIG_ZMK_STUDIO_LOCKING=n
CONFIG_ZMK_STUDIO_LOCK_ON_DISCONNECT=n

# Set TX power level
CONFIG_BT_CTLR_TX_PWR_PLUS_8=y

CONFIG_USB_DEVICE_MANUFACTURER="DEEMEN17 WORKS"
CONFIG_USB_DEVICE_PRODUCT="DEKY65"

CONFIG_ZMK_HID_INDICATORS=y
CONFIG_ZMK_BLE=y

CONFIG_LED=y

CONFIG_ZMK_KSCAN_DEBOUNCE_PRESS_MS=15
CONFIG_ZMK_KSCAN_DEBOUNCE_RELEASE_MS=15

# Config module rgbled widget
CONFIG_RGBLED_WIDGET=y
CONFIG_RGBLED_WIDGET_CAPS=y
CONFIG_RGBLED_WIDGET_CONN_BLINK_MS=2000
```

## boards/arm/deow/Kconfig
```kconfig
# Copyright (c) 2024 Deemen17 Works
# SPDX-License-Identifier: MIT

config BOARD_ENABLE_DCDC
    bool "Enable DCDC mode"
    select SOC_DCDC_NRF52X
    default y
    depends on BOARD_DEOW
```

## boards/arm/deow/Kconfig.board
```kconfig
# Copyright (c) 2024 Deemen17 Works
# SPDX-License-Identifier: MIT

config BOARD_DEOW
    bool "deow"
    depends on SOC_NRF52840_QIAA
```

## boards/arm/deow_rev2/Kconfig.board
```kconfig
# Copyright (c) 2024 Deemen17 Works
# SPDX-License-Identifier: MIT

config BOARD_DEOW_REV2
    bool "deow"
    depends on SOC_NRF52840_QIAA
```

## boards/arm/deow_rev2/deow_rev2_defconfig
```kconfig
# Copyright (c) 2024 Deemen17 Works
# SPDX-License-Identifier: MIT

CONFIG_SOC_SERIES_NRF52X=y
CONFIG_SOC_NRF52840_QIAA=y
CONFIG_BOARD_DEOW_REV2=y

# Enable MPU
CONFIG_ARM_MPU=y

CONFIG_PINCTRL=y

# Enable GPIO
CONFIG_GPIO=y

CONFIG_USE_DT_CODE_PARTITION=y
CONFIG_BUILD_OUTPUT_UF2=y

CONFIG_MPU_ALLOW_FLASH_WRITE=y
CONFIG_NVS=y
CONFIG_SETTINGS_NVS=y
CONFIG_FLASH=y
CONFIG_FLASH_PAGE_LAYOUT=y
CONFIG_FLASH_MAP=y

# Enable RGB Underglow
CONFIG_ZMK_RGB_UNDERGLOW=y
CONFIG_WS2812_STRIP=y

# External Power Control
CONFIG_ZMK_EXT_POWER=y

# Configure RGB Underglow
CONFIG_ZMK_RGB_UNDERGLOW_EXT_POWER=y
CONFIG_ZMK_RGB_UNDERGLOW_AUTO_OFF_IDLE=y
CONFIG_ZMK_RGB_UNDERGLOW_ON_START=y
CONFIG_ZMK_RGB_UNDERGLOW_EFF_START=3

# Turn on logging, and set ZMK logging to debug output
# CONFIG_ZMK_USB_LOGGING=y

# Power Management Configuration
# Milliseconds of inactivity before entering idle state	- 10 minutes
CONFIG_ZMK_IDLE_TIMEOUT=600000 
CONFIG_ZMK_SLEEP=y
# Milliseconds of inactivity before entering deep sleep	- 20 minites
CONFIG_ZMK_IDLE_SLEEP_TIMEOUT=1200000 
# 20min
CONFIG_ZMK_PM_SOFT_OFF=y

# Battery Level
CONFIG_ZMK_BATTERY=y
CONFIG_ZMK_BATTERY_REPORTING=y

# ZMK Studio Configuration
CONFIG_ZMK_STUDIO=y
CONFIG_ZMK_STUDIO_LOCKING=n
CONFIG_ZMK_STUDIO_LOCK_ON_DISCONNECT=n

# Set TX power level
CONFIG_BT_CTLR_TX_PWR_PLUS_8=y  
# Sometimes recommended if used in a metal enclosure

CONFIG_ZMK_HID_INDICATORS=y
CONFIG_LED=y

CONFIG_USB_DEVICE_MANUFACTURER="DEEMEN17 WORKS"
CONFIG_USB_DEVICE_PRODUCT="DEOW REV2"
```

## config/west.yml
```yaml
manifest:
  remotes:
    - name: zmkfirmware
      url-base: https://github.com/zmkfirmware
    - name: awkannan
      url-base: https://github.com/awkannan
    - name: Deemen17
      url-base: https://github.com/Deemen17
  projects:
    - name: zmk
      remote: zmkfirmware
      revision: main
      import: app/west.yml
    - name: zmk-gpio-behavior
      remote: awkannan
      revision: main
    - name: zmk-rgbled-widget 
      remote: Deemen17
      revision: main
  self:
    path: config
```
